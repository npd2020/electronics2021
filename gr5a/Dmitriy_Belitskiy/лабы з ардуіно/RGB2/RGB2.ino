#define B 9   //задаємо піни до яких підєднано світлодіод
#define R 10
#define G 11


void setup() {
  Serial.begin(9600); //це для відладки
  pinMode(R,OUTPUT);//настраюємо порти на вихід
  pinMode(G,OUTPUT);
  pinMode(B,OUTPUT);

}
int r1=0;
int b1=0;//можна сказати, що це швидкість з якою будуть змінюватися кольори
int g1=0;

bool lr=1;
bool lg=1; 
bool lb=1;
int c=5;

int r=100;
int g=5;    //ці змінні задають початковий стан світлодіода
int b=200;

void loop() 

{
 if(lb){ b1=random(0, c);};
 if(lb!=1){ b1=-random(0, c);};
 if(lr) { r1=random(0, c);};
 if(lr!=1){ r1=-random(0, c);};  //швидкість зміни яскравості світлодіода беремо випадкову,
 if(lg) { g1=random(0, c);};
 if(lg!=1){g1=-random(0, c);};
 
 
 
 
 for (int i=0;i<4;i++){
 b=b+b1;
 r=r+r1;
 g=g+g1;
 analogWrite(B,b);
 analogWrite(R,r); //вмикаємо світлодіоди
 analogWrite(G,g);
 delay(10);
 Serial.println(r);//це для відладки

  if (b>=200){lb=0;};
  if (b<=30){lb=1;};
  if (r>=200){lr=0;};
  if (r<=30){lr=1;};    //ця конструкція відповідає за те, щоб яскравість світлодіодів не вийщла за межі дозволеного
   if (g>=200){lg=0;};  //межі взагалі то становлять від 0 до 255, але программа все одно виходила за межі, бо вихід за межі перевіряється лише
  if (g<=30){lg=1;};     // після виконання циклу for, тому я виставив межі від 30 до 200.
}

}
